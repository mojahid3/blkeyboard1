## sdkconfig.defaults
```kconfig
CONFIG_BT_ENABLED=y
CONFIG_BT_CONTROLLER_ENABLED=y
CONFIG_BT_CLASSIC_ENABLED=y
CONFIG_BT_HID_HOST_ENABLED=y
CONFIG_BT_BLE_ENABLED=n
CONFIG_BT_NIMBLE_ENABLED=n
CONFIG_FREERTOS_HZ=1000
CONFIG_LCD_PANEL_IO_FORMAT_BUF_SIZE=60
CONFIG_LCD_RGB_ISR_IRAM_SAFE=y
CONFIG_IDF_TARGET_ESP32S3=y
CONFIG_IDF_TARGET_ESP32S3=y
CONFIG_MBEDTLS_PSK_MODES=y
CONFIG_MBEDTLS_KEY_EXCHANGE_PSK=y
CONFIG_SOC_LCD_RGB_SUPPORTED=y
```
